## conf/bblayers.conf.sample
```bitbake
# LAYER_CONF_VERSION is increased each time build/conf/bblayers.conf
# changes incompatibly
LCONF_VERSION = "6"

BBPATH = "${TOPDIR}"
BBFILES ?= ""

BBLAYERS ?= " \
  $HOME/poky/meta \
  $HOME/poky/meta-yocto \
  $HOME/poky/meta-yocto-bsp \
  $HOME/poky/meta-overc \
  $HOME/poky/meta-overc/meta-cube \
  $HOME/poky/meta-openembedded/meta-oe \
  $HOME/poky/meta-openembedded/meta-gnome \
  $HOME/poky/meta-openembedded/meta-xfce \
  $HOME/poky/meta-virtualization \
  $HOME/poky/meta-openembedded/meta-python \
  $HOME/poky/meta-openembedded/meta-networking \
  $HOME/poky/meta-openembedded/meta-multimedia \
  $HOME/poky/meta-cloud-services \
  $HOME/poky/meta-qt4 \
  $HOME/poky/oe-meta-go \
  $HOME/poky/meta-openembedded/meta-filesystems \
  "
BBLAYERS_NON_REMOVABLE ?= " \
  $HOME/poky/meta \
  $HOME/poky/meta-yocto \
  "
```

## conf/distro/overc.conf
```bitbake
DISTRO = "overc"
DISTRO_NAME = "overc"
DISTRO_VERSION = "1.0"
DISTRO_CODENAME = ""
SDK_VENDOR = "-overc-sdk"
SDK_VERSION := "${@'${DISTRO_VERSION}'.replace('snapshot-${DATE}','snapshot')}"

MAINTAINER = "Wind River <windriver@windriver.com>"

TARGET_VENDOR = "-overc"

LOCALCONF_VERSION = "1"
LAYER_CONF_VERSION ?= "6"

OVERC_DEFAULT_DISTRO_FEATURES = "largefile opengl ptest multiarch wayland alsa argp bluetooth ext2 usbgadget usbhost wifi xattr nfs zeroconf pci x11 pam"
OVERC_DEFAULT_EXTRA_RDEPENDS = "packagegroup-core-boot"
OVERC_DEFAULT_EXTRA_RRECOMMENDS = "kernel-module-af-packet"

DISTRO_FEATURES ?= "${DISTRO_FEATURES_LIBC} ${OVERC_DEFAULT_DISTRO_FEATURES}"
INHERIT_DISTRO ?= " debian devshell sstate license package-name"

# multlib configs
require conf/multilib.conf
MULTILIBS = "multilib:lib32"
DEFAULTTUNE_virtclass-multilib-lib32 = "x86"

PREFERRED_VERSION_linux-yocto ?= "4.1%"
PREFERRED_VERSION_linux-yocto_qemux86 ?= "4.1%"
PREFERRED_VERSION_linux-yocto_qemux86-64 ?= "4.1%"
PREFERRED_VERSION_linux-yocto_qemuarm ?= "4.1%"
PREFERRED_VERSION_linux-yocto_qemumips ?= "4.1%"
PREFERRED_VERSION_linux-yocto_qemumips64 ?= "4.1%"
PREFERRED_VERSION_linux-yocto_qemuppc ?= "4.1%"

SDK_NAME = "${DISTRO}-${TCLIBC}-${SDK_ARCH}-${IMAGE_BASENAME}-${TUNE_PKGARCH}"
SDKPATH = "/opt/${DISTRO}/${SDK_VERSION}"

EXTRAOPKGCONFIG = "overc-feed-config-opkg"

DISTRO_EXTRA_RDEPENDS += " ${OVERC_DEFAULT_EXTRA_RDEPENDS}"
DISTRO_EXTRA_RRECOMMENDS += " ${OVERC_DEFAULT_EXTRA_RRECOMMENDS}"

LICENSE_FLAGS_WHITELIST += " commercial"

OVERCQEMUDEPS = "${@bb.utils.contains("INCOMPATIBLE_LICENSE", "GPLv3", "", "packagegroup-core-device-devel",d)}"
DISTRO_EXTRA_RDEPENDS_append_qemuarm = " ${OVERCQEMUDEPS}"
DISTRO_EXTRA_RDEPENDS_append_qemuarm64 = " ${OVERCQEMUDEPS}"
DISTRO_EXTRA_RDEPENDS_append_qemumips = " ${OVERCQEMUDEPS}"
DISTRO_EXTRA_RDEPENDS_append_qemuppc = " ${OVERCQEMUDEPS}"
DISTRO_EXTRA_RDEPENDS_append_qemux86 = " ${OVERCQEMUDEPS}"
DISTRO_EXTRA_RDEPENDS_append_qemux86-64 = " ${OVERCQEMUDEPS}"

DISTRO_FEATURES_append = " systemd"
VIRTUAL-RUNTIME_init_manager = "systemd"
DISTRO_FEATURES_BACKFILL_CONSIDERED += "sysvinit"

VIRTUAL-RUNTIME_graphical_init_manager ?= "lxdm"

TCLIBCAPPEND = ""

QEMU_TARGETS ?= "arm aarch64 i386 mips mipsel ppc x86_64"
# Other QEMU_TARGETS "mips64 mips64el sh4"

PREMIRRORS ??= "\
bzr://.*/.*   http://downloads.yoctoproject.org/mirror/sources/ \n \
cvs://.*/.*   http://downloads.yoctoproject.org/mirror/sources/ \n \
git://.*/.*   http://downloads.yoctoproject.org/mirror/sources/ \n \
gitsm://.*/.* http://downloads.yoctoproject.org/mirror/sources/ \n \
hg://.*/.*    http://downloads.yoctoproject.org/mirror/sources/ \n \
osc://.*/.*   http://downloads.yoctoproject.org/mirror/sources/ \n \
p4://.*/.*    http://downloads.yoctoproject.org/mirror/sources/ \n \
svn://.*/.*   http://downloads.yoctoproject.org/mirror/sources/ \n"

MIRRORS =+ "\
ftp://.*/.*      http://downloads.yoctoproject.org/mirror/sources/ \n \
http://.*/.*     http://downloads.yoctoproject.org/mirror/sources/ \n \
https://.*/.*    http://downloads.yoctoproject.org/mirror/sources/ \n"

# The CONNECTIVITY_CHECK_URI's are used to test whether we can succesfully
# fetch from the network (and warn you if not). To disable the test set
# the variable to be empty.
# Git example url: git://git.yoctoproject.org/yocto-firewall-test;protocol=git;rev=HEAD

CONNECTIVITY_CHECK_URIS ?= " \
             https://eula-downloads.yoctoproject.org/index.php \
             http://bugzilla.yoctoproject.org/report.cgi"

SANITY_TESTED_DISTROS ?= " \
            overc-1.0 \n \
            poky-1.8 \n \
            poky-2.0 \n \
            poky-2.1 \n \
            poky-2.2 \n \
            ubuntu-14.04 \n \
            ubuntu-14.10 \n \
            ubuntu-15.04 \n \
            ubuntu-15.10 \n \
            ubuntu-16.04 \n \
            ubuntu-16.10 \n \
            fedora-22 \n \
            fedora-23 \n \
            fedora-24 \n \
            centos-7 \n \
            debian-8 \n \
            opensuse-13.2 \n \
            opensuse-42.1 \n \
            "

# Default hash policy for distro
BB_SIGNATURE_HANDLER ?= 'OEBasicHash'
#
# OELAYOUT_ABI allows us to notify users when the format of TMPDIR changes in
# an incompatible way. Such changes should usually be detailed in the commit
# that breaks the format and have been previously discussed on the mailing list
# with general agreement from the core team.
#
OELAYOUT_ABI = "10"

# QA check settings - a little stricter than the OE-Core defaults
WARN_QA = "textrel files-invalid incompatible-license xorg-driver-abi libdir \
           unknown-configure-option build-deps file-rdeps"
ERROR_QA = "dev-so debug-deps dev-deps debug-files arch pkgconfig la perms \
            useless-rpaths rpaths staticdev ldflags pkgvarcheck already-stripped \
            compile-host-path dep-cmp installed-vs-shipped install-host-path \
            packages-list perm-config perm-line perm-link pkgv-undefined \
            pn-overrides split-strip var-undefined version-going-backwards"

# Build gnome-keyring
PNBLACKLIST[gnome-keyring] = ""
PNBLACKLIST[gcr] = "Incompatible with gnome-keyring"
```

## conf/layer.conf
```bitbake
# We have a conf and classes directory, add to BBPATH
BBPATH .= ":${LAYERDIR}"

# We have recipes-* directories, add to BBFILES
BBFILES += "${@bb.utils.contains('DISTRO', 'overc', '${LAYERDIR}/recipes-*/*/*.bb  ${LAYERDIR}/recipes-*/*/*.bbappend', '', d)}"

BBFILE_COLLECTIONS += "overc"
BBFILE_PATTERN_overc = "${@bb.utils.contains('DISTRO', 'overc', '^${LAYERDIR}/', '', d)}"
BBFILE_PRIORITY_overc = "1"

# This should only be incremented on significant changes that will
# cause compatibility issues with other layers
LAYERVERSION_overc = "1"
LAYERDEPENDS_overc = "core"
LAYERSERIES_COMPAT_overc = "sumo thud"
```

## meta-cube/conf/layer.conf
```bitbake
# We have a conf and classes directory, add to BBPATH
BBPATH .= ":${LAYERDIR}"

# We have recipes-* directories, add to BBFILES
BBFILES += "${LAYERDIR}/recipes-*/*/*.bb ${LAYERDIR}/recipes-*/*/*.bbappend"

BBFILE_COLLECTIONS += "cube"
BBFILE_PATTERN_cube = "${@bb.utils.contains('DISTRO', 'overc', '^${LAYERDIR}/', '', d)}"
BBFILE_PRIORITY_cube = "8"

BB_DANGLINGAPPENDS_WARNONLY ?= "true"

# This should only be incremented on significant changes that will
# cause compatibility issues with other layers
LAYERVERSION_cube = "1"

LAYERDEPENDS_cube = "core"

# Grub2 is annoying but grub-legacy doesn't do ext4 w/o patches
#PREFERRED_VERSION_grub = "0.97"

# The uprev to 0.2.4 doesn't even build :(  so use the older one for now.
PREFERRED_VERSION_xfce4-notifyd = "0.2.2"

# Default is only a single getty on VC1
SYSVINIT_ENABLED_GETTYS = "1 2 3 4 5 6"

# Requires a corresponding recipe patch
SYSVINIT_ENABLED_CTRLALTDEL = "1"

# May not be right for you, but at least you know what to set/change.
DEFAULT_TIMEZONE = "America/Toronto"

FILESYSTEM_PERMS_TABLES = "files/fs-perms.txt files/cube-fs-perms.txt"

# Use latest dev kernel.
PREFERRED_PROVIDER_virtual/kernel ?= "linux-yocto-dev"

# Default is currently /home/root which is non-standard.
ROOT_HOME = "/root"

####  begin busybox removal ####

# Hammer approach ; change login_manager instead after looking at bitbake -e
# RDEPENDS_packagegroup-core-full-cmdline-initscripts_remove = "busybox"
VIRTUAL-RUNTIME_login_manager = "shadow"

# Actions like "remove" are one item per line, not a list!
RDEPENDS_packagegroup-core-boot_remove = "busybox"
RDEPENDS_packagegroup-core-boot_remove = "busybox-hwclock"
RDEPENDS_packagegroup-core-full-cmdline-sys-services_remove = "lighttpd"

SYSVINIT_SCRIPTS_remove_pn-packagegroup-core-boot = "busybox-hwclock"

####  end busybox removal ####

# OVERC_ESSENTIAL_MODE describes the read/write mode of essential rootfs in OverC. By
# default, essential rootfs is read-only. To change it to read-write, please update
# value to "read-write", then rebuild essential rootfs.
OVERC_ESSENTIAL_MODE = "read-only"
```

## meta-pod/conf/bblayers.conf.sample
```bitbake
# LAYER_CONF_VERSION is increased each time build/conf/bblayers.conf
# changes incompatibly
LCONF_VERSION = "6"

BBPATH = "${TOPDIR}"
BBFILES ?= ""

BBLAYERS ?= " \
  /home/paul/poky/meta \
  /home/paul/poky/meta-yocto \
  /home/paul/poky/meta-yocto-bsp \
  /home/paul/poky/meta-overc/meta-pod \
  /home/paul/poky/meta-openembedded/meta-oe \
  /home/paul/poky/meta-openembedded/meta-gnome \
  /home/paul/poky/meta-openembedded/meta-xfce \
  /home/paul/poky/meta-virtualization \
  /home/paul/poky/meta-openembedded/meta-python \
  /home/paul/poky/meta-openembedded/meta-networking \
  /home/paul/poky/meta-openembedded/meta-multimedia \
  "
BBLAYERS_NON_REMOVABLE ?= " \
  /home/paul/poky/meta \
  /home/paul/poky/meta-yocto \
  "
```

## meta-pod/conf/distro/pod.conf
```bitbake
DISTRO = "pod"
DISTRO_NAME = "pod"
DISTRO_VERSION = "1.0"
DISTRO_CODENAME = ""
SDK_VENDOR = "-pod-sdk"
SDK_VERSION := "${@'${DISTRO_VERSION}'.replace('snapshot-${DATE}','snapshot')}"

MAINTAINER = "Wind River <windriver@windriver.com>"

TARGET_VENDOR = "-overc"

LOCALCONF_VERSION = "1"
LAYER_CONF_VERSION ?= "6"

POD_DEFAULT_DISTRO_FEATURES = "largefile opengl ptest multiarch wayland alsa argp bluetooth ext2 usbgadget usbhost wifi xattr nfs zeroconf pci x11 pam"
POD_DEFAULT_EXTRA_RDEPENDS = "packagegroup-core-boot"
POD_DEFAULT_EXTRA_RRECOMMENDS = "kernel-module-af-packet"

DISTRO_FEATURES ?= "${DISTRO_FEATURES_LIBC} ${POD_DEFAULT_DISTRO_FEATURES}"

# multlib configs
require conf/multilib.conf
MULTILIBS = "multilib:lib32"
DEFAULTTUNE_virtclass-multilib-lib32 = "x86"

PREFERRED_VERSION_linux-yocto ?= "3.19%"
PREFERRED_VERSION_linux-yocto_qemux86 ?= "3.19%"
PREFERRED_VERSION_linux-yocto_qemux86-64 ?= "3.19%"
PREFERRED_VERSION_linux-yocto_qemuarm ?= "3.19%"
PREFERRED_VERSION_linux-yocto_qemumips ?= "3.19%"
PREFERRED_VERSION_linux-yocto_qemumips64 ?= "3.19%"
PREFERRED_VERSION_linux-yocto_qemuppc ?= "3.19%"

SDK_NAME = "${DISTRO}-${TCLIBC}-${SDK_ARCH}-${IMAGE_BASENAME}-${TUNE_PKGARCH}"
SDKPATH = "/opt/${DISTRO}/${SDK_VERSION}"

EXTRAOPKGCONFIG = "pod-feed-config-opkg"

DISTRO_EXTRA_RDEPENDS += " ${POD_DEFAULT_EXTRA_RDEPENDS}"
DISTRO_EXTRA_RRECOMMENDS += " ${POD_DEFAULT_EXTRA_RRECOMMENDS}"

LICENSE_FLAGS_WHITELIST += " commercial"

PODQEMUDEPS = "${@bb.utils.contains("INCOMPATIBLE_LICENSE", "GPLv3", "", "packagegroup-core-device-devel",d)}"
DISTRO_EXTRA_RDEPENDS_append_qemuarm = " ${PODQEMUDEPS}"
DISTRO_EXTRA_RDEPENDS_append_qemuarm64 = " ${PODQEMUDEPS}"
DISTRO_EXTRA_RDEPENDS_append_qemumips = " ${PODQEMUDEPS}"
DISTRO_EXTRA_RDEPENDS_append_qemuppc = " ${PODQEMUDEPS}"
DISTRO_EXTRA_RDEPENDS_append_qemux86 = " ${PODQEMUDEPS}"
DISTRO_EXTRA_RDEPENDS_append_qemux86-64 = " ${PODQEMUDEPS}"

DISTRO_FEATURES_append = " systemd"
VIRTUAL-RUNTIME_init_manager = "systemd"
DISTRO_FEATURES_BACKFILL_CONSIDERED += "sysvinit"

VIRTUAL-RUNTIME_graphical_init_manager ?= "lxdm"

TCLIBCAPPEND = ""

QEMU_TARGETS ?= "arm aarch64 i386 mips mipsel ppc x86_64"
# Other QEMU_TARGETS "mips64 mips64el sh4"

PREMIRRORS ??= "\
bzr://.*/.*   http://downloads.yoctoproject.org/mirror/sources/ \n \
cvs://.*/.*   http://downloads.yoctoproject.org/mirror/sources/ \n \
git://.*/.*   http://downloads.yoctoproject.org/mirror/sources/ \n \
gitsm://.*/.* http://downloads.yoctoproject.org/mirror/sources/ \n \
hg://.*/.*    http://downloads.yoctoproject.org/mirror/sources/ \n \
osc://.*/.*   http://downloads.yoctoproject.org/mirror/sources/ \n \
p4://.*/.*    http://downloads.yoctoproject.org/mirror/sources/ \n \
svk://.*/.*   http://downloads.yoctoproject.org/mirror/sources/ \n \
svn://.*/.*   http://downloads.yoctoproject.org/mirror/sources/ \n"

MIRRORS =+ "\
ftp://.*/.*      http://downloads.yoctoproject.org/mirror/sources/ \n \
http://.*/.*     http://downloads.yoctoproject.org/mirror/sources/ \n \
https://.*/.*    http://downloads.yoctoproject.org/mirror/sources/ \n"

# The CONNECTIVITY_CHECK_URI's are used to test whether we can succesfully
# fetch from the network (and warn you if not). To disable the test set
# the variable to be empty.
# Git example url: git://git.yoctoproject.org/yocto-firewall-test;protocol=git;rev=HEAD

CONNECTIVITY_CHECK_URIS ?= " \
             https://eula-downloads.yoctoproject.org/index.php \
             http://bugzilla.yoctoproject.org/report.cgi"

SANITY_TESTED_DISTROS ?= " \
            Ubuntu-12.04 \n \
            Ubuntu-14.04 \n \
            Ubuntu-14.10 \n \
            Fedora-20 \n \
            CentOS-6.5 \n \
            Debian-7.* \n \
            Debian-8.* \n \
            openSUSE-project-12.3 \n \
            openSUSE-project-13.1 \n \
            "

# Default hash policy for distro
BB_SIGNATURE_HANDLER ?= 'OEBasicHash'
#
# OELAYOUT_ABI allows us to notify users when the format of TMPDIR changes in
# an incompatible way. Such changes should usually be detailed in the commit
# that breaks the format and have been previously discussed on the mailing list
# with general agreement from the core team.
#
OELAYOUT_ABI = "10"

# QA check settings - a little stricter than the OE-Core defaults
WARN_QA = "textrel files-invalid incompatible-license xorg-driver-abi libdir \
           unknown-configure-option build-deps file-rdeps"
ERROR_QA = "dev-so debug-deps dev-deps debug-files arch pkgconfig la perms \
            useless-rpaths rpaths staticdev ldflags pkgvarcheck already-stripped \
            compile-host-path dep-cmp installed-vs-shipped install-host-path \
            packages-list perm-config perm-line perm-link pkgv-undefined \
            pn-overrides split-strip var-undefined version-going-backwards"
```
