## meta-pod/conf/layer.conf
```bitbake
# We have a conf and classes directory, add to BBPATH
BBPATH .= ":${LAYERDIR}"

# We have recipes-* directories, add to BBFILES
BBFILES += "${LAYERDIR}/recipes-*/*/*.bb ${LAYERDIR}/recipes-*/*/*.bbappend"

BBFILE_COLLECTIONS += "pod"
BBFILE_PATTERN_pod = "^${LAYERDIR}/"
BBFILE_PRIORITY_pod = "1"

# This should only be incremented on significant changes that will
# cause compatibility issues with other layers
LAYERVERSION_pod = "1"

LAYERDEPENDS_pod = "core"

# Grub2 is annoying but grub-legacy does't do ext4 w/o patches
#PREFERRED_VERSION_grub = "0.97"

# Default is only a single getty on VC1
SYSVINIT_ENABLED_GETTYS = "1 2 3 4 5 6"

# Requires a corresponding recipe patch
SYSVINIT_ENABLED_CTRLALTDEL = "1"

# Add sbin triplet to $PATH ; Requires a corresponding base-files patch
SBIN_FOR_NON_ROOT = "1"

# May not be right for you, but at least you know what to set/change.
DEFAULT_TIMEZONE = "America/Toronto"

FILESYSTEM_PERMS_TABLES = "files/fs-perms.txt files/pod-fs-perms.txt"

# Use latest dev kernel.
PREFERRED_PROVIDER_virtual/kernel = "linux-yocto-dev"

# Default is currently /home/root which is non-standard.
ROOT_HOME = "/root"

####  begin busybox removal ####

# Hammer approach ; change login_manager instead after looking at bitbake -e
# RDEPENDS_packagegroup-core-full-cmdline-initscripts_remove = "busybox"
VIRTUAL-RUNTIME_login_manager = "shadow"

# Actions like "remove" are one item per line, not a list!
RDEPENDS_packagegroup-core-boot_remove = "busybox"
RDEPENDS_packagegroup-core-boot_remove = "busybox-hwclock"
RDEPENDS_packagegroup-core-full-cmdline-sys-services_remove = "lighttpd"

SYSVINIT_SCRIPTS_remove_pn-packagegroup-core-boot = "busybox-hwclock"

####  end busybox removal ####
```
